; --------------------------------------------------------------------------------
; @Title: FreeRTOS Demo for TRACE32 RTOS Debugger
; @Description: 
;   
;   This batchfile loads all necessary files to demonstrate
;   the RTOS Debugger for FreeRTOS.
;   
; @Keywords: awareness, RTOS, FreeRTOS
; @Author: DIE
; @Copyright: (C) 1989-2014 Lauterbach GmbH, licensed for use with TRACE32(R) only
; --------------------------------------------------------------------------------
; $Id: freertos.cmm 9161 2016-03-15 10:12:54Z rdienstbeck $

 SCREEN.ON
 WinPAGE.RESet
 WinPOS 0. 25. 70. 7. 0. 0. W000
 AREA.view

; Debugger reset
 PRINT "resetting..."
 SYStem.RESet

; initialize debugger
 PRINT "initializing..."
 SYStem.Up

; load sample application
 PRINT "loading sample application..."
 Data.LOAD.Elf rtosdemo.elf
 
; initialize RTOS support
 PRINT "initializing FreeRTOS support..."
 TASK.CONFIG ./freertos.t32       ; load FreeRTOS awareness
 MENU.ReProgram ./freertos.men    ; load FreeRTOS menu
 HELP.FILTER.Add rtosfreertos   ; add FreeRTOS awareness manual to filtered help

 PRINT "load complete."
 
; open some windows
 WinPOS 0. 0. 70. 20.
 List.auto
 WinPOS 48. 5. 65. 20. 0. 1. W001
 TASK.TaskList

; start application
 Go vLEDFlashTask

 ENDDO
 
