; --------------------------------------------------------------------------------
; @Title: LiteOS Demo for TRACE32 OS Awareness
; @Description: 
;   
;   This batchfile loads all necessary files to demonstrate
;   the OS Awareness for LiteOS on STM32F429I-DISCO.
;   
; @Keywords: Awareness, LiteOS, RTOS
; @Author: YDA
; @Copyright: (C) 1989-2022 Lauterbach GmbH, licensed for use with TRACE32(R) only
; --------------------------------------------------------------------------------
; $Id: liteos.cmm 18850 2022-01-26 18:41:29Z bschroefel $


SCREEN.ON
AREA.RESet
WinPAGE.RESet
WinCLEAR
WinPOS 0. 27. 63. 7. 0. 0. W006
AREA.view

; Debugger reset
PRINT "resetting..."
RESet
SYStem.RESet

; Initializing Debugger
PRINT "initializing..."
SYStem.CPU STM32F429ZI
SYStem.CONFIG.DEBUGPORTTYPE SWD
SYStem.MemAccess DAP
SYStem.Option DUALPORT ON
SYStem.Up

; Load application
PRINT "loading application..."
Data.LOAD.Elf liteos_stm32f4.elf

; Initialize RTOS support
PRINT "initializing LiteOS support..."
TASK.CONFIG ~~/demo/arm/kernel/liteos/liteos.t32      ; load LiteOS awareness
MENU.ReProgram ~~/demo/arm/kernel/liteos/liteos.men   ; load LiteOS menu

PRINT "load complete."  ; send to Message Line

; Open some windows
WinPOS 0.0 0.0 73. 23. 11. 1. W001
WinTABS 16. 10. 25. 62.
List.auto

WinPOS 78.286 0.16667 90. 8. 0. 1. W000
WinTABS 10. 3. 18. 12. 5. 9.
TASK.Task

; Start application
Go LOS_Demo_Tskfunc

ENDDO
